## CMakeLists.txt
```
# SPDX-License-Identifier: Apache-2.0

cmake_minimum_required(VERSION 3.13.1)
find_package(Zephyr REQUIRED HINTS $ENV{ZEPHYR_BASE})

project(app LANGUAGES C CXX)

include(${CMAKE_CURRENT_LIST_DIR}/../../cmake/git_version.cmake)

target_include_directories(app PRIVATE ${ZEPHYR_TT_SYSTEM_FIRMWARE_MODULE_DIR}/lib/tenstorrent/bh_arc)

if(CONFIG_BH_FWTABLE)
  target_include_directories(app PRIVATE ${CMAKE_BINARY_DIR}/modules/tt-system-firmware/drivers/misc/bh_fwtable/spirom_protobufs)
  add_dependencies(app nanopb_generated_headers)
endif()

target_sources(app PRIVATE src/main.c)

# C++ header soak test: proves the Zephyr and tt-system-firmware headers we
# use are C++-clean.
target_sources(app PRIVATE ${CMAKE_CURRENT_LIST_DIR}/../cpp_header_soak.cpp)
```

## prj.conf
```kconfig
# C++ support (header soak test compiles app/cpp_header_soak.cpp as C++)
CONFIG_CPP=y

# logging
CONFIG_LOG=y
CONFIG_TT_APP_LOG_LEVEL_INF=y

CONFIG_ARC_USE_UNALIGNED_MEM_ACCESS=y
CONFIG_HW_STACK_PROTECTION=n
CONFIG_SYS_CLOCK_TICKS_PER_SEC=100000
CONFIG_TICKLESS_KERNEL=y

# I2C
CONFIG_MULTI_LEVEL_INTERRUPTS=y
CONFIG_I2C_DW=y
CONFIG_I2C=y
CONFIG_I2C_TARGET=y
CONFIG_SMBUS=y
CONFIG_SMBUS_TARGET=y

# PVT sensor driver
CONFIG_SENSOR=y
CONFIG_RTIO=y
CONFIG_SENSOR_ASYNC_API=y

# stack
# These default to 1024 on ARC.
CONFIG_SYSTEM_WORKQUEUE_STACK_SIZE=2048

# Disable printing the default Zephyr boot banner
CONFIG_BOOT_BANNER=n
# Print the Tenstorrent boot banner + git version on startup
CONFIG_TT_BOOT_BANNER=y
CONFIG_TT_BOOT_BANNER_SDK_VERSION=y

# Enable FPU with context switching
CONFIG_FPU=y
CONFIG_FPU_SHARING=y

# Select ramload with revert mode
CONFIG_BOOTLOADER_MCUBOOT=y
CONFIG_MCUBOOT_BOOTLOADER_MODE_RAM_LOAD_WITH_REVERT=y

# Enable the flash manager so we can confirm the image
CONFIG_FLASH=y
CONFIG_FLASH_MAP=y
CONFIG_STREAM_FLASH=y
CONFIG_IMG_MANAGER=y
CONFIG_MCUBOOT_IMG_MANAGER=y

# Enable retained memory and retention
CONFIG_RETAINED_MEM=y
CONFIG_RETENTION=y
CONFIG_RETAINED_MEM_ZEPHYR_RAM=y
CONFIG_RETENTION_BOOTLOADER_INFO=y
CONFIG_RETENTION_BOOTLOADER_INFO_TYPE_MCUBOOT=y

# Generate unsigned images by default
# To sign FW, use SB_CONFIG_BOOT_SIGNATURE_KEY_FILE="/path/to/key.pem"
CONFIG_MCUBOOT_GENERATE_UNSIGNED_IMAGE=y

# Enable the Zbus notification/observer subsystem.
CONFIG_ZBUS=y
CONFIG_ZBUS_RUNTIME_OBSERVERS_NODE_ALLOC_NONE=y

# Binary descriptors for firmware version
CONFIG_BINDESC=y
CONFIG_BINDESC_DEFINE=y
CONFIG_BINDESC_DEFINE_VERSION=y
CONFIG_BINDESC_APP_VERSION_STRING=y
CONFIG_TT_BINDESC=y
```

## src/main.c
```c
/*
 * Copyright (c) 2024 Tenstorrent AI ULC
 * SPDX-License-Identifier: Apache-2.0
 */

#include "cm2dm_msg.h"
#include "dvfs.h"
#include "fan_ctrl.h"
#include "init.h"
#include "reg.h"
#include "smbus_target.h"
#include "status_reg.h"
#include "telemetry.h"
#include "timer.h"

#include <stdint.h>

#include <app_version.h>
#include <tenstorrent/msgqueue.h>
#include <tenstorrent/post_code.h>
#include <zephyr/init.h>
#include <zephyr/kernel.h>
#include <zephyr/logging/log.h>
#include <zephyr/drivers/watchdog.h>
#include <zephyr/drivers/misc/bh_fwtable.h>

LOG_MODULE_REGISTER(main, CONFIG_TT_APP_LOG_LEVEL);

static const struct device *const wdt0 = DEVICE_DT_GET(DT_NODELABEL(wdt0));
static const struct device *const fwtable_dev = DEVICE_DT_GET(DT_NODELABEL(fwtable));

int main(void)
{
	SetPostCode(POST_CODE_SRC_CMFW, POST_CODE_ZEPHYR_INIT_DONE);
	printk("Tenstorrent Blackhole CMFW %s\n", APP_VERSION_STRING);

	k_float_enable(k_current_get(), 0);

	if (!IS_ENABLED(CONFIG_TT_SMC_RECOVERY)) {
		if (tt_bh_fwtable_get_fw_table(fwtable_dev)->feature_enable.aiclk_ppm_en) {
			STATUS_ERROR_STATUS0_reg_u error_status0 = {
				.val = ReadReg(STATUS_ERROR_STATUS0_REG_ADDR)
			};

			if (error_status0.f.regulator_init_error) {
				LOG_ERR("Not enabling AICLK PPM due to regulator init error");
			} else {
				/* DVFS should get enabled if AICLK PPM or L2CPUCLK PPM is enabled
				 * We currently don't have plans to implement L2CPUCLK PPM,
				 * so currently, dvfs_enable == aiclk_ppm_enable
				 */
				InitDVFS();
			}
		}
	}

	init_msgqueue();

	if (!IS_ENABLED(CONFIG_TT_SMC_RECOVERY)) {
		init_telemetry(APPVERSION);
		if (tt_bh_fwtable_get_fw_table(fwtable_dev)->feature_enable.fan_ctrl_en) {
			init_fan_ctrl();
		}

		/* These timers are split out from their init functions since their work tasks have
		 * i2c conflicts with other init functions.
		 *
		 * Note: The above issue would be solved by using Zephyr's driver model.
		 */
		StartTelemetryTimer();
		if (dvfs_enabled) {
			StartDVFSTimer();
		}
	}

	Dm2CmReadyRequest();

	while (1) {
		sys_trace_named_event("main_loop", TimerTimestamp(), 0);
		k_msleep(CONFIG_TT_BH_ARC_WDT_FEED_INTERVAL);
		wdt_feed(wdt0, 0);
	}

	return 0;
}

#define FW_VERSION_SEMANTIC APPVERSION
#define FW_VERSION_DATE     0x00000000
#define FW_VERSION_LOW      0x00000000
#define FW_VERSION_HIGH     0x00000000

uint32_t FW_VERSION[4] __attribute__((section(".fw_version"))) = {
	FW_VERSION_SEMANTIC, FW_VERSION_DATE, FW_VERSION_LOW, FW_VERSION_HIGH};

static int tt_appversion_init(void)
{
	WriteReg(STATUS_FW_VERSION_REG_ADDR, APPVERSION);
	return 0;
}
SYS_INIT(tt_appversion_init, EARLY, 0);

static int record_cmfw_start_time(void)
{
	WriteReg(CMFW_START_TIME_REG_ADDR, TimerTimestamp());
	return 0;
}
SYS_INIT(record_cmfw_start_time, EARLY, 0);

static int bh_arc_init_start(void)
{
	/* Write a status register indicating HW init progress */
	STATUS_BOOT_STATUS0_reg_u boot_status0 = {0};

	boot_status0.val = ReadReg(STATUS_BOOT_STATUS0_REG_ADDR);
	boot_status0.f.hw_init_status = kHwInitStarted;
	WriteReg(STATUS_BOOT_STATUS0_REG_ADDR, boot_status0.val);

	SetPostCode(POST_CODE_SRC_CMFW, POST_CODE_ARC_INIT_STEP1);
	SetPostCode(POST_CODE_SRC_CMFW, POST_CODE_ARC_INIT_STEP2);

	return 0;
}
SYS_INIT(bh_arc_init_start, APPLICATION, 3);

int tt_init_status;

static int bh_arc_init_end(void)
{
	STATUS_BOOT_STATUS0_reg_u boot_status0 = {0};

	/* Indicate successful HW Init */
	boot_status0.val = ReadReg(STATUS_BOOT_STATUS0_REG_ADDR);
	/* Record FW ID */
	if (IS_ENABLED(CONFIG_TT_SMC_RECOVERY)) {
		boot_status0.f.fw_id = FW_ID_SMC_RECOVERY;
	} else {
		boot_status0.f.fw_id = FW_ID_SMC_NORMAL;
	}
	boot_status0.f.hw_init_status = (tt_init_status == 0) ? kHwInitDone : kHwInitError;
	WriteReg(STATUS_BOOT_STATUS0_REG_ADDR, boot_status0.val);
	WriteReg(STATUS_ERROR_STATUS0_REG_ADDR, error_status0.val);

	return 0;
}
SYS_INIT(bh_arc_init_end, APPLICATION, 22);

#ifdef CONFIG_FPU_SHARING

static void enable_float_on_current(struct k_work *work)
{
	k_float_enable(k_current_get(), 0);
}

static K_WORK_DEFINE(enable_float_work, enable_float_on_current);

static int enable_float_sys_work_q(void)
{
	k_work_submit(&enable_float_work);
	return 0;
}

/* The system workqueue is created at POST_KERNEL, CONFIG_KERNEL_INIT_PRIORITY_DEFAULT.
 * We must enable FPU saving after that, but before any work items that might use the FPU.
 */
SYS_INIT(enable_float_sys_work_q, POST_KERNEL, UTIL_INC(CONFIG_KERNEL_INIT_PRIORITY_DEFAULT));

#endif
```
